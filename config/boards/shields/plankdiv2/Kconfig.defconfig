## config/boards/shields/plankdiv2/Kconfig.defconfig
```kconfig
# Copyright (c) 2020 The ZMK Contributors
# SPDX-License-Identifier: MIT

if SHIELD_PLANKDIV2_LEFT

config ZMK_KEYBOARD_NAME
    default "plankdiv2"

config ZMK_SPLIT_ROLE_CENTRAL
    default y

endif

if SHIELD_PLANKDIV2_LEFT || SHIELD_PLANKDIV2_RIGHT

config ZMK_SPLIT
    default y

endif
```

## config/boards/shields/plankdiv2/Kconfig.shield
```kconfig
# Copyright (c) 2020 The ZMK Contributors
# SPDX-License-Identifier: MIT

config SHIELD_PLANKDIV2_LEFT
    def_bool $(shields_list_contains,plankdiv2_left)

config SHIELD_PLANKDIV2_RIGHT
    def_bool $(shields_list_contains,plankdiv2_right)
```
